// OpenMoto Phase 6: portable core of the ACK-ONLY CAN bring-up tool.
//
// No Arduino dependencies: this header compiles for the ATmega2560 (avr-g++)
// and for the host (clang++), so the exact decision logic that runs on the
// board is exercised offline against a simulated CAN controller
// (tests/diag_ack_host/ack_sim.cpp).
//
// PURPOSE
//   Decide whether the diagnostic connector is a healthy CAN bus BEFORE any
//   KOMBI 22 F1 50 request (Phase 5). It distinguishes four conditions that a
//   passive LISTEN_ONLY capture cannot tell apart:
//     * healthy bus (another node acknowledges)
//     * no-ACK bus (we were the only listener; the earlier 0x130 case)
//     * wrong bitrate
//     * wrong / absent physical connection
//   plus "frames seen but the diagnostic gateway is silent" (deferred to Phase 5).
//
// WHY ACK-ONLY IS ACTIVE PARTICIPATION (read this)
//   The MCP2515 has NO mode that acknowledges received frames without also being
//   able to transmit. ACK generation only happens in NORMAL mode. So "ACK-only"
//   is NOT a passive mode: in NORMAL mode the controller drives the bus's ACK
//   slot dominant for every valid frame it receives, and it emits CAN error
//   frames on bit/stuff/CRC/form errors. That is real, active transmission on
//   the bus. The only thing this core guarantees is that NO application frame is
//   ever queued: no TX buffer is loaded, no Request-To-Send is issued. ACKs and
//   error frames are generated by CAN hardware, not by us loading a buffer.
//
// SAFETY MODEL
//   * Idle state is LISTEN_ONLY (truly silent) or CONFIG.
//   * ACK-only (NORMAL, no TX) is entered only after explicit ARM + CONFIRM, for
//     a bounded window, then automatically reverts to LISTEN_ONLY.
//   * Error counters (TEC/REC) are polled continuously; if either crosses a low
//     threshold, or any bus-off/error-passive flag appears, the core falls back
//     to LISTEN_ONLY (or CONFIG) immediately. A disturbed bus (wrong bitrate)
//     is detected within milliseconds and we stop driving it.
//   * There is NO transmit path compiled in at all: the HAL has no "load TX
//     buffer" or "request to send" method. This is enforced structurally.
#pragma once
#include <stdint.h>
#include <string.h>

namespace ackbringup {

// ---- Limits (compile-time; no runtime override) -----------------------------
constexpr uint32_t ARM_TTL_MS = 30000;        // armed confirmation lifetime
constexpr uint32_t ACK_WINDOW_MS = 2000;      // max time in ACK-only NORMAL mode
constexpr uint32_t POLL_MS = 20;              // error-counter / state poll period
constexpr uint8_t TEC_FALLBACK = 16;          // transmit-error count -> fall back
constexpr uint8_t REC_FALLBACK = 96;          // receive-error count -> fall back (near passive)
constexpr uint8_t MAX_RUNS = 10;              // ACK-only runs per power cycle
constexpr uint8_t ACK_LINE_MAX = 48;

// Controller state snapshot the HAL must provide (read from CANSTAT/EFLG/TEC/REC).
struct BusStats {
    uint32_t rxCount;   // frames received since power-on
    uint8_t tec;        // transmit error counter
    uint8_t rec;        // receive error counter
    uint8_t eflg;       // EFLG register (error flags)
    bool errorPassive;  // derived from EFLG/TEC
    bool busOff;        // derived from EFLG/TEC
    bool mode_normal;   // CANSTAT reports NORMAL
    bool spiError;      // SPI readback self-check failed this poll
};

// Hardware abstraction. NOTE: there is deliberately NO transmit method.
class AckHal {
public:
    virtual ~AckHal() {}
    virtual uint32_t nowMs() = 0;
    virtual int readChar() = 0;
    virtual void putChar(char c) = 0;
    // Enter/verify truly-silent LISTEN_ONLY. true if verified.
    virtual bool enterListenOnly() = 0;
    // Enter/verify CONFIG (fully off the bus). true if verified.
    virtual bool enterConfig() = 0;
    // Enter NORMAL mode with EVERY TX buffer confirmed empty (TXREQ=0) and no
    // RTS ever issued -> ACK-only. true only if NORMAL verified AND no TXREQ set.
    virtual bool enterAckOnly() = 0;
    // Current controller stats (counters/flags/mode/rx count).
    virtual void readStats(BusStats &s) = 0;
    // Assert that no TX buffer is pending (TXREQ clear on all three). The core
    // calls this during the ACK window; false triggers an immediate fallback.
    virtual bool noTxPending() = 0;
};

// ---- Output helper (same shape as diag_core.h Out) ----------------------------
struct Out {
    AckHal &h;
    explicit Out(AckHal &hal) : h(hal) {}
    void s(const char *p) { while (*p) h.putChar(*p++); }
    void hex(uint8_t v) {
        static const char D[] = "0123456789ABCDEF";
        h.putChar(D[v >> 4]); h.putChar(D[v & 15]);
    }
    void u(uint32_t v) {
        char b[11]; uint8_t i = 0;
        do { b[i++] = char('0' + v % 10); v /= 10; } while (v);
        while (i) h.putChar(b[--i]);
    }
    void nl() { h.putChar('\n'); }
};

// ---- Verdict of one bring-up run ----------------------------------------------
enum Verdict : uint8_t {
    V_NONE,
    V_HEALTHY_ACKED,     // frames rx AND our ACKs accepted, counters stayed clean
    V_NO_ACK_WAS_US,     // passive saw frames+errors; ACK-only cleaned them -> we were the missing ACKer
    V_WRONG_BITRATE,     // rx=0 (or garbage) and REC/TEC climbed fast -> bitrate wrong
    V_NO_CONNECTION,     // rx=0 and counters stayed 0 -> nothing on the wire / not connected
    V_FRAMES_NO_DIAG,    // healthy acked frames, but no response to us (gateway/diag deferred)
    V_FAULT_FALLBACK     // a fault forced fallback before a conclusion
};
inline const char *verdictText(Verdict v) {
    switch (v) {
    case V_HEALTHY_ACKED: return "HEALTHY_BUS_ACK_ACCEPTED";
    case V_NO_ACK_WAS_US: return "NO_ACK_WAS_MISSING_ACKER";
    case V_WRONG_BITRATE: return "WRONG_BITRATE";
    case V_NO_CONNECTION: return "NO_CONNECTION_OR_SILENT_BUS";
    case V_FRAMES_NO_DIAG: return "FRAMES_PRESENT_NO_DIAG_REPLY";
    case V_FAULT_FALLBACK: return "FAULT_FORCED_FALLBACK";
    default: return "NONE";
    }
}

// ---- Bring-up shell + state machine -------------------------------------------
class AckShell {
public:
    explicit AckShell(AckHal &hal) : h(hal), o(hal) {}

    void begin() {
        o.s("OpenMoto Phase 6 ACK-ONLY CAN bring-up\n");
        o.s("ACK-only is ACTIVE bus participation (hardware ACK + error frames)\n");
        o.s("NOT FOR VEHICLE USE until docs/diag-ack-bringup.md prerequisites are met\n");
        if (!h.enterListenOnly()) {
            estopped = true;
            o.s("ALERT listen-only-unverified at boot; latched off\n");
        }
        o.s("READY send STATUS\n");
    }

    void poll() {
        int ch;
        for (uint8_t budget = 48; budget && (ch = h.readChar()) >= 0; --budget) onChar(char(ch));
        const uint32_t now = h.nowMs();
        if (state == S_ARMED && elapsed(now, armedAt) > ARM_TTL_MS) disarm("expired");
        if (state == S_PASSIVE || state == S_ACKONLY) step(now);
    }

    bool isEstopped() const { return estopped; }

private:
    enum State : uint8_t { S_IDLE, S_ARMED, S_PASSIVE, S_ACKONLY, S_DONE };

    AckHal &h;
    Out o;
    State state = S_IDLE;
    char line[ACK_LINE_MAX + 1];
    uint8_t lineLen = 0;
    bool lineOverflow = false;
    bool estopped = false, lockedOut = false;
    uint8_t runCount = 0;
    uint16_t armCode = 0, armSeq = 0;
    uint32_t armedAt = 0;

    // run bookkeeping
    uint32_t phaseStart = 0, lastPoll = 0;
    uint32_t passiveRxBase = 0, activeRxBase = 0;
    uint32_t passiveRx = 0, activeRx = 0;
    uint8_t passiveEflg = 0, passiveRec = 0;
    BusStats cur{};
    Verdict verdict = V_NONE;

    static uint32_t elapsed(uint32_t now, uint32_t since) { return uint32_t(now - since); }
    static bool beyond(uint32_t now, uint32_t since, uint32_t ms) { return elapsed(now, since) > ms; }

    static int hexVal(char c) {
        if (c >= '0' && c <= '9') return c - '0';
        if (c >= 'a' && c <= 'f') return c - 'a' + 10;
        if (c >= 'A' && c <= 'F') return c - 'A' + 10;
        return -1;
    }
    static bool parseHex4(const char *s, uint16_t &out) {
        if (strlen(s) != 4) return false;
        uint16_t v = 0;
        for (uint8_t i = 0; i < 4; ++i) { int d = hexVal(s[i]); if (d < 0) return false; v = uint16_t(v << 4 | d); }
        out = v; return true;
    }

    void onChar(char c) {
        if (c == '!') { lineLen = 0; lineOverflow = false; emergencyStop("bang"); return; }
        if (c == '\r') return;
        if (c == '\n') {
            line[lineLen] = 0;
            const bool ovf = lineOverflow; const uint8_t len = lineLen;
            lineLen = 0; lineOverflow = false;
            if (ovf) { o.s("ERR line-too-long\n"); return; }
            if (len) execLine();
            return;
        }
        if (lineLen < ACK_LINE_MAX) line[lineLen++] = c; else lineOverflow = true;
    }

    void execLine() {
        char *tok[4]; uint8_t nt = 0; char *p = line;
        while (*p && nt < 4) {
            while (*p == ' ' || *p == '\t') *p++ = 0;
            if (!*p) break;
            tok[nt++] = p;
            while (*p && *p != ' ' && *p != '\t') ++p;
        }
        if (nt == 0) return;
        for (char *c = tok[0]; *c; ++c) if (*c >= 'a' && *c <= 'z') *c = char(*c - 32);
        const char *cmd = tok[0];
        if (!strcmp(cmd, "STATUS")) { cmdStatus(); return; }
        if (!strcmp(cmd, "ESTOP")) { emergencyStop("command"); return; }
        if (!strcmp(cmd, "HELP")) { cmdHelp(); return; }
        if (estopped || lockedOut) { o.s(estopped ? "ERR estop-latched\n" : "ERR lockout\n"); return; }
        if (!strcmp(cmd, "ARM")) cmdArm();
        else if (!strcmp(cmd, "CONFIRM")) cmdConfirm(tok + 1, nt - 1);
        else if (!strcmp(cmd, "STOP")) { fallback("command"); o.s("OK stopped\n"); }
        else o.s("ERR unknown-command (STATUS ARM CONFIRM STOP ESTOP HELP)\n");
    }

    void cmdHelp() {
        o.s("ACK-only bring-up: ARM, then CONFIRM <code>. Runs a passive window then a\n");
        o.s("bounded ACK-only (NORMAL, no TX) window and prints a verdict. '!'=estop.\n");
    }

    void cmdStatus() {
        BusStats s; h.readStats(s);
        o.s("STATUS state=");
        o.s(state == S_IDLE ? "IDLE" : state == S_ARMED ? "ARMED" :
            state == S_PASSIVE ? "PASSIVE" : state == S_ACKONLY ? "ACKONLY" : "DONE");
        o.s(" runs="); o.u(runCount);
        o.s(" mode="); o.s(s.mode_normal ? "NORMAL" : "SILENT");
        o.s(" tec="); o.u(s.tec); o.s(" rec="); o.u(s.rec);
        o.s(" eflg="); hexOut(s.eflg);
        o.s(" estop="); o.u(estopped);
        o.nl();
    }
    void hexOut(uint8_t v) { o.s("0x"); o.hex(v); }

    void cmdArm() {
        if (state != S_IDLE) { o.s("ERR busy\n"); return; }
        if (runCount >= MAX_RUNS) { o.s("ERR run-limit reset-required\n"); return; }
        const uint32_t now = h.nowMs();
        uint32_t x = 2166136261UL;
        const uint8_t mix[] = {uint8_t(armSeq), uint8_t(armSeq >> 8), uint8_t(now),
                               uint8_t(now >> 8), uint8_t(now >> 16), uint8_t(runCount)};
        for (uint8_t i = 0; i < sizeof(mix); ++i) { x ^= mix[i]; x *= 16777619UL; }
        armCode = uint16_t((x >> 16) ^ x);
        if (armCode == 0) armCode = 0xA11C;
        ++armSeq; armedAt = now; state = S_ARMED;
        o.s("ARMED code="); o.hex(uint8_t(armCode >> 8)); o.hex(uint8_t(armCode));
        o.s(" action=ack-only-bringup note=ACTIVE-participation expires_ms="); o.u(ARM_TTL_MS);
        o.nl();
    }

    void cmdConfirm(char **a, uint8_t n) {
        if (state != S_ARMED) { o.s("ERR not-armed\n"); return; }
        uint16_t code;
        if (n != 1 || !parseHex4(a[0], code) || code != armCode) { disarm("bad-code"); return; }
        if (elapsed(h.nowMs(), armedAt) > ARM_TTL_MS) { disarm("expired"); return; }
        armCode = 0;
        startRun();
    }

    void disarm(const char *why) {
        if (state == S_ARMED) state = S_IDLE;
        armCode = 0;
        o.s("DISARMED reason="); o.s(why); o.nl();
    }

    // ---- the bring-up run: PASSIVE window, then ACK-ONLY window, then verdict.
    void startRun() {
        verdict = V_NONE;
        activeRx = passiveRx = 0;
        passiveEflg = passiveRec = 0;
        // Phase A: a short truly-silent LISTEN_ONLY observation.
        if (!h.enterListenOnly()) { finish(V_FAULT_FALLBACK, "listen-only-enter-failed"); return; }
        h.readStats(cur);
        if (cur.spiError) { finish(V_FAULT_FALLBACK, "spi-error-at-start"); return; }
        passiveRxBase = cur.rxCount;
        phaseStart = lastPoll = h.nowMs();
        state = S_PASSIVE;
        o.s("RUN passive-window-start (LISTEN_ONLY, silent)\n");
    }

    void step(uint32_t now) {
        if (elapsed(now, lastPoll) < POLL_MS) return;
        lastPoll = now;
        h.readStats(cur);

        // SPI integrity is checked every poll in both windows.
        if (cur.spiError) { finish(V_FAULT_FALLBACK, "spi-error"); return; }

        if (state == S_PASSIVE) {
            if (beyond(now, phaseStart, ACK_WINDOW_MS)) {
                passiveRx = cur.rxCount - passiveRxBase;
                passiveEflg = cur.eflg;    // RX-error flags accrued while passive (we never ACK)
                passiveRec = cur.rec;
                // Enter ACK-only (NORMAL, no TX). ACTIVE participation starts here.
                if (!h.enterAckOnly()) { finish(V_FAULT_FALLBACK, "ack-only-enter-failed"); return; }
                if (!h.noTxPending()) { finish(V_FAULT_FALLBACK, "tx-pending-at-entry"); return; }
                h.readStats(cur);
                if (!cur.mode_normal) { finish(V_FAULT_FALLBACK, "normal-not-verified"); return; }
                activeRxBase = cur.rxCount;
                phaseStart = now;
                state = S_ACKONLY;
                o.s("RUN ack-only-window-start (NORMAL, no TX, ACTIVE: generates ACK/error frames)\n");
            }
            return;
        }

        // state == S_ACKONLY -----------------------------------------------------
        // Continuous fault guard: any error escalation -> immediate fallback.
        if (cur.busOff || cur.errorPassive || cur.tec >= TEC_FALLBACK || cur.rec >= REC_FALLBACK) {
            const uint32_t rx = cur.rxCount - activeRxBase;
            // Error escalation with little/no reception is the wrong-bitrate signature.
            finish(rx < 2 ? V_WRONG_BITRATE : V_FAULT_FALLBACK, "error-counter-escalation");
            return;
        }
        if (!cur.mode_normal) { finish(V_FAULT_FALLBACK, "left-normal-unexpectedly"); return; }
        if (!h.noTxPending()) { finish(V_FAULT_FALLBACK, "unexpected-tx-pending"); return; }

        if (beyond(now, phaseStart, ACK_WINDOW_MS)) {
            activeRx = cur.rxCount - activeRxBase;
            verdict = classify();
            finish(verdict, "window-complete");
        }
    }

    // Decide among the four conditions from the two windows + counters.
    Verdict classify() const {
        const bool passiveSawErrors = (passiveEflg & 0xC0) != 0 || passiveRec > 0;  // RX err while passive
        if (activeRx == 0 && passiveRx == 0) {
            // Nothing received in either window.
            if (cur.tec == 0 && cur.rec == 0 && (cur.eflg & 0xFF) == 0)
                return V_NO_CONNECTION;        // wire quiet, no errors: not connected / silent bus
            return V_WRONG_BITRATE;            // quiet to us but errors: our bit timing disagrees
        }
        if (activeRx > 0) {
            // We received frames while actively ACKing and counters stayed clean.
            // If the passive window showed receive errors (the lone-transmitter /
            // no-ACK signature) that cleared once we ACKed, we were the missing ACKer.
            return passiveSawErrors ? V_NO_ACK_WAS_US : V_HEALTHY_ACKED;
        }
        // Passive saw frames but active saw none: inconsistent -> treat as bitrate.
        return V_WRONG_BITRATE;
    }

    void finish(Verdict v, const char *why) {
        // ALWAYS return to a silent state first.
        bool silent = h.enterListenOnly();
        if (!silent) { silent = h.enterConfig(); if (silent) o.s("NOTE fell back to CONFIG\n"); }
        if (!silent) { estopped = true; o.s("ALERT silent-mode-unverified; latched off\n"); }
        ++runCount;
        state = S_IDLE;
        BusStats s; h.readStats(s);
        o.s("RESULT verdict="); o.s(verdictText(v));
        o.s(" reason="); o.s(why);
        o.s(" passive_rx="); o.u(passiveRx);
        o.s(" passive_eflg=0x"); o.hex(passiveEflg);
        o.s(" active_rx="); o.u(activeRx);
        o.s(" tec="); o.u(cur.tec); o.s(" rec="); o.u(cur.rec);
        o.s(" eflg=0x"); o.hex(cur.eflg);
        o.s(" spi_err="); o.u(s.spiError);
        o.s(" silent="); o.u(silent);
        o.s(" fresh_confirm_required=1");
        o.nl();
    }

    void emergencyStop(const char *why) {
        estopped = true; armCode = 0;
        fallback(why);
        o.s("EVT estop reason="); o.s(why); o.s(" latched=1\n");
    }

    void fallback(const char *why) {
        (void)why;
        if (!h.enterListenOnly()) h.enterConfig();
        if (state != S_DONE) state = S_IDLE;
        armCode = 0;
    }
};

}  // namespace ackbringup
